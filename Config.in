## Config.in
```kconfig
source "$BR2_EXTERNAL_PIBUNNY_PATH/package/pibunny/Config.in"
source "$BR2_EXTERNAL_PIBUNNY_PATH/package/python-blinkt/Config.in"
source "$BR2_EXTERNAL_PIBUNNY_PATH/package/python-rpigpio/Config.in"
```

## package/pibunny/Config.in
```kconfig
config BR2_PACKAGE_PIBUNNY
        bool "pibunny"
        help
          Install Pibunny package

          https://github.com/peterbay/uvc-gadget
```

## package/python-blinkt/Config.in
```kconfig
config BR2_PACKAGE_PYTHON_BLINKT
	bool "python-blinkt"
	select BR2_PACKAGE_PYTHON_RPIGPIO # runtime
	help
	  Python library for driving Pimoroni Blinkt!.

	  http://www.pimoroni.com
```

## package/python-rpigpio/Config.in
```kconfig
config BR2_PACKAGE_PYTHON_RPIGPIO
	bool "python-rpigpio"
	help
	  A module to control Raspberry Pi GPIO channels.

	  http://sourceforge.net/projects/raspberry-gpio-python/
```

## package/rspiducky/Config.in
```kconfig
config BR2_PACKAGE_RSPIDUCKY
        bool "rspiducky"
        help
          Install rspiducky package

          https://github.com/msjmeyer/rspiducky
```
